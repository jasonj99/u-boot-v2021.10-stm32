## arch/arm/mach-stm32/stm32f7/Kconfig
```kconfig
if STM32F7

config TARGET_STM32F746_DISCO
	bool "STM32F746 Discovery board"

source "board/st/stm32f746-disco/Kconfig"

config TARGET_DRAGONLI3
	bool "Dragonli3 STM32F746 board"

source "board/st/dragonli3/Kconfig"

endif
```

## board/st/dragonli3/Kconfig
```kconfig
if TARGET_DRAGONLI3

config SYS_BOARD
	string
	default "dragonli3"

config SYS_VENDOR
	string
	default "st"

config SYS_SOC
	string
	default "stm32f7"

config SYS_CONFIG_NAME
	string
	default "dragonli3"

endif
```
